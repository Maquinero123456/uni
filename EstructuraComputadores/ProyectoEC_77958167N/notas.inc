/* frecuencias */

.set FA, 700    @ Retardo para nota Fa = F
.set SOLs, 830 @ Retardo para nota SOLs = Gs
.set LA, 870     @ Retardo para nota La = A
.set LAs, 932
.set SI, 970
.set DO, 543
.set SOL, 784
.set MI, 659
.set RE, 597
.set FAs, 740
.set DOH, 996    @ Retardo para nota DoH = cH

.set DOHs, 902
.set REH, 851
.set REHs, 803

.set MIH, 758     @ Retardo para nota MIH = eH
.set FAH, 716     @ Retardo para nota FAH = FH
.set FAHs, 676
.set SOLH, 638
.set SOLHs, 602
.set LAH, 568
.set SIb, 1072
.set REs, 1607
.set DOs, 1850


.set SILEN, 5  @silencio


/* duraciones */

.set NG,  500000
.set CORP,  375000
.set COR,    250000
.set FUS,   125000
.set BL, 1000000
.set SOMBRERO, 2000000
